## hitcon-2020/atoms/src/linux/drivers/misc/atoms/Kconfig
```kconfig
config ATOMS
  tristate "A TOken-based Memory Storage by david942j"
  default m
  depends on X86
```

## hitcon-2020/spark/src/linux/drivers/misc/spark/Kconfig
```kconfig
config SPARK
  tristate "Shortest Path AlgoRithm in Kernel by david942j"
  default m
  depends on X86
```

## hitcon-quals-2019/PoE/src/linux/drivers/misc/tpu/Kconfig
```kconfig
config TPU
  tristate "Treap Processing Unit driver by david942j"
  default m
  depends on PCI && X86
```
